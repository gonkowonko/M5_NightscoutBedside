#include "display.h"

#include <M5Unified.h>

#include <algorithm>

namespace {

// ---- Layout (320x240 landscape, buttons at the bottom) ----------------------
constexpr int kW = 320;
constexpr int kH = 240;
constexpr int kPadX = 14;
constexpr int kPadTop = 10;
constexpr int kPadBottom = 12;
constexpr int kContentW = kW - 2 * kPadX;  // 292: every region is this wide

constexpr int kTopY = kPadTop;
constexpr int kTopH = 22;
constexpr int kStripH = 62;
constexpr int kStripY = kH - kPadBottom - kStripH;  // 166
constexpr int kDividerY = kStripY - 1;              // 165
constexpr int kClockY = kTopY + kTopH + 8;          // 40
constexpr int kClockH = kDividerY - 1 - kClockY;    // 124

constexpr int kBandH = 32;  // band sprite: 292 x 32 x 16 bit = 18.7 KB

// Bottom strip, relative to the strip's top.
constexpr int kBgCenterY = kStripH / 2;
constexpr int kDeltaCenterY = 22;
constexpr int kAgeCenterY = 45;
constexpr int kArrowGap = 12;
constexpr int kArrowBox = 34;
constexpr int kDoubleArrowGap = 20;  // DoubleUp/DoubleDown: second arrow offset

// ---- Colours (RGB888) -------------------------------------------------------
constexpr uint32_t kBg = 0x000000u;
constexpr uint32_t kClockColor = 0xF3F4F6u;
constexpr uint32_t kDim = 0x9CA3AFu;
constexpr uint32_t kDivider = 0x262626u;  // neutral grey
constexpr uint32_t kGrey = 0x6B7280u;
constexpr uint32_t kRed = 0xF87171u;
constexpr uint32_t kAmber = 0xFBBF24u;
constexpr uint32_t kGreen = 0x4ADE80u;

uint32_t rangeColor(BgRange r) {
  switch (r) {
    case BgRange::Urgent: return kRed;
    case BgRange::Warning: return kAmber;
    default: return kGreen;
  }
}

// ---- Fonts ------------------------------------------------------------------

// The .vlw fonts (generated by tools/make_fonts.py) are embedded in the
// firmware image via board_build.embed_files and read straight from flash,
// so they cost no RAM and change with a normal firmware update.
#define EMBEDDED_FONT(name)                                                   \
  extern const uint8_t name##_start[] asm("_binary_fonts_" #name "_vlw_start"); \
  extern const uint8_t name##_end[] asm("_binary_fonts_" #name "_vlw_end");
EMBEDDED_FONT(clock)
EMBEDDED_FONT(bg)
EMBEDDED_FONT(delta)
EMBEDDED_FONT(title)
EMBEDDED_FONT(text18)
EMBEDDED_FONT(text14)

struct Face {
  lgfx::PointerWrapper data;
  lgfx::VLWfont vlw;
  int digitH = 0;  // height of "0" above the baseline, for vertical centring

  Face(const uint8_t* start, const uint8_t* end) : data(start, end - start) {}
};

Face gClockFace(clock_start, clock_end);
Face gBgFace(bg_start, bg_end);
Face gDeltaFace(delta_start, delta_end);
Face gTextFace(text18_start, text18_end);  // date, temperature
Face gSmallFace(text14_start, text14_end);  // "N min ago", splash checklist
Face gTitleFace(title_start, title_end);    // splash title
Face* const gFaces[] = {&gClockFace, &gBgFace, &gDeltaFace, &gTextFace, &gSmallFace, &gTitleFace};

uint32_t be32(const uint8_t* p) { return (uint32_t)p[0] << 24 | p[1] << 16 | p[2] << 8 | p[3]; }

// Reads a glyph's top offset (height above the baseline) from the VLW
// metrics table: "0" for fonts with digits, else "H".
int vlwDigitHeight(lgfx::DataWrapper& d, int count) {
  uint8_t m[28];
  int capH = 0;
  for (int i = 0; i < count; i++) {
    d.seek(24 + i * 28);
    if (d.read(m, sizeof(m)) != sizeof(m)) break;
    if (be32(m) == '0') return (int32_t)be32(m + 16);
    if (be32(m) == 'H') capH = (int32_t)be32(m + 16);
  }
  return capH;
}

void loadFace(Face& f) {
  if (!f.vlw.loadFont(&f.data)) {
    Serial.println("display: embedded font failed to load");
    return;
  }
  f.digitH = vlwDigitHeight(f.data, f.vlw.gCount);
}

LGFX_Sprite gBand(&M5.Display);

enum class Align { Left, Center, Right };

// Draws text vertically centred on the digits at centerY. Returns its width.
int drawText(LGFX_Sprite& s, const Face& f, const char* text, int x, int centerY, Align align,
             uint32_t color) {
  s.setFont(&f.vlw);
  s.setTextSize(1);
  s.setTextColor(color);  // no background: anti-aliasing blends with the sprite
  s.setTextDatum(align == Align::Left    ? textdatum_t::baseline_left
                 : align == Align::Right ? textdatum_t::baseline_right
                                         : textdatum_t::baseline_center);
  s.drawString(text, x, centerY + f.digitH / 2);
  return s.textWidth(text);
}

// Renders one full-width region through the band sprite, top to bottom.
// `draw` receives the sprite and the y offset of the band within the region.
template <typename F>
void renderRegion(int y, int h, F&& draw) {
  for (int by = 0; by < h; by += kBandH) {
    int bh = std::min(kBandH, h - by);
    gBand.fillScreen(kBg);
    draw(gBand, -by);
    M5.Display.pushImage(kPadX, y + by, kContentW, bh,
                         static_cast<const lgfx::swap565_t*>(gBand.getBuffer()));
  }
}

// ---- Trend arrow ------------------------------------------------------------

float trendAngle(Trend t) {  // degrees, 0 = right, positive = clockwise (down)
  switch (t) {
    case Trend::DoubleUp:
    case Trend::SingleUp: return -90;
    case Trend::FortyFiveUp: return -45;
    case Trend::Flat: return 0;
    case Trend::FortyFiveDown: return 45;
    default: return 90;  // SingleDown, DoubleDown
  }
}

// A line with a chevron head, centred on (cx, cy).
void drawArrow(LGFX_Sprite& s, float cx, float cy, float angleDeg, uint32_t color) {
  constexpr float kLen = kArrowBox - 6;
  constexpr float kHead = kArrowBox * 0.4f;
  constexpr float kStroke = 2.5f;  // radius, i.e. 5 px wide
  float a = angleDeg * DEG_TO_RAD;
  float dx = cosf(a), dy = sinf(a);
  float hx = cx + dx * kLen / 2, hy = cy + dy * kLen / 2;
  float tx = cx - dx * kLen / 2, ty = cy - dy * kLen / 2;
  s.drawWideLine(tx, ty, hx, hy, kStroke, color);
  for (float side : {-1.0f, 1.0f}) {
    float b = a + PI + side * PI / 4;
    s.drawWideLine(hx, hy, hx + cosf(b) * kHead, hy + sinf(b) * kHead, kStroke, color);
  }
}

void drawTrend(LGFX_Sprite& s, Trend t, int x, int cy, uint32_t color) {
  if (t == Trend::None) return;
  float angle = trendAngle(t);
  if (t == Trend::DoubleUp || t == Trend::DoubleDown) {
    drawArrow(s, x + kArrowBox / 2, cy, angle, color);
    drawArrow(s, x + kArrowBox / 2 + kDoubleArrowGap, cy, angle, color);
  } else {
    drawArrow(s, x + kArrowBox / 2.0f, cy, angle, color);
  }
}

// ---- Regions ----------------------------------------------------------------

ScreenModel gShown;  // what is currently on the screen
bool gFullRedraw = true;
bool gDebugShown = false;
bool gProgressShown = false;

void drawTopLine(const ScreenModel& m) {
  renderRegion(kTopY, kTopH, [&](LGFX_Sprite& s, int oy) {
    int cy = oy + kTopH / 2;
    drawText(s, gTextFace, m.date, 0, cy, Align::Left, kDim);
    drawText(s, gTextFace, m.temp, kContentW, cy, Align::Right, kDim);
  });
}

void drawClock(const ScreenModel& m) {
  renderRegion(kClockY, kClockH, [&](LGFX_Sprite& s, int oy) {
    drawText(s, gClockFace, m.time, kContentW / 2, oy + kClockH / 2, Align::Center, kClockColor);
  });
}

void drawStrip(const ScreenModel& m) {
  renderRegion(kStripY, kStripH, [&](LGFX_Sprite& s, int oy) {
    int cy = oy + kBgCenterY;
    if (!m.hasBg) {
      drawText(s, gBgFace, "---", 0, cy, Align::Left, kGrey);
      drawText(s, gSmallFace, m.age, kContentW, oy + kAgeCenterY, Align::Right, m.ageAlert ? kRed : kDim);
      return;
    }
    uint32_t color = m.stale ? kGrey : rangeColor(m.range);
    int w = drawText(s, gBgFace, m.bg, 0, cy, Align::Left, color);
    if (m.stale) s.fillRect(0, cy - 2, w, 4, kGrey);  // strike-through
    drawTrend(s, m.trend, w + kArrowGap, cy, color);

    if (m.delta[0]) {
      // Typographic minus for negative deltas.
      char delta[12];
      if (m.delta[0] == '-')
        snprintf(delta, sizeof(delta), "\xE2\x88\x92%s", m.delta + 1);
      else
        strlcpy(delta, m.delta, sizeof(delta));
      drawText(s, gDeltaFace, delta, kContentW, oy + kDeltaCenterY, Align::Right, color);
    }
    drawText(s, gSmallFace, m.age, kContentW, oy + kAgeCenterY, Align::Right,
             m.ageAlert ? kRed : kDim);
  });
}

bool stripChanged(const ScreenModel& a, const ScreenModel& b) {
  return a.hasBg != b.hasBg || strcmp(a.bg, b.bg) || strcmp(a.delta, b.delta) ||
         a.trend != b.trend || a.range != b.range || a.stale != b.stale || strcmp(a.age, b.age) ||
         a.ageAlert != b.ageAlert;
}

// ---- Startup splash ---------------------------------------------------------

constexpr int kSplashHeadY = 6;    // logo, title, version
constexpr int kSplashHeadH = 116;
constexpr int kSplashListY = 124;  // checklist
constexpr int kSplashRowH = 19;
constexpr int kSplashListH = 4 * kSplashRowH;
constexpr int kSplashRuleY = kSplashListY + kSplashListH + 6;
constexpr int kSplashFootY = kSplashRuleY + 4;
constexpr int kSplashFootH = kH - kSplashFootY - 2;
constexpr int kSplashIconX = 60;    // content coordinates (x = 0 at the 14px pad)
constexpr int kSplashLabelX = 70;
constexpr int kSplashDetailX = 232;

bool gSplashShown = false;
SplashModel gSplashDrawn;

// Crescent moon with a green "blip": the project's mark.
void drawLogo(LGFX_Sprite& s, int cx, int cy) {
  s.fillSmoothCircle(cx, cy, 24, kClockColor);
  s.fillSmoothCircle(cx + 13, cy - 9, 20, kBg);
  s.fillSmoothCircle(cx + 14, cy + 8, 5, kGreen);
}

void drawStepIcon(LGFX_Sprite& s, StepState st, int x, int cy, uint8_t frame) {
  switch (st) {
    case StepState::Ok:
      s.drawWideLine(x - 5, cy, x - 2, cy + 3, 1.0f, kGreen);
      s.drawWideLine(x - 2, cy + 3, x + 4, cy - 4, 1.0f, kGreen);
      break;
    case StepState::Fail:
      s.drawWideLine(x - 4, cy - 4, x + 3, cy + 3, 1.0f, kRed);
      s.drawWideLine(x + 3, cy - 4, x - 4, cy + 3, 1.0f, kRed);
      break;
    case StepState::Wait:
      for (int i = 0; i < 3; i++)
        s.fillSmoothCircle(x - 6 + i * 5, cy, 2, i == frame ? kClockColor : kGrey);
      break;
    default:
      s.drawCircle(x - 1, cy, 2, kGrey);
      break;
  }
}

bool sameStep(const SplashStep& a, const SplashStep& b) {
  return a.state == b.state && !strcmp(a.label, b.label) && !strcmp(a.detail, b.detail);
}

// ---- Debug page -------------------------------------------------------------

constexpr int kDebugMaxLines = 14;
char gDebugLines[kDebugMaxLines][48];

}  // namespace

void displayBegin() {
  M5.Display.setRotation(1);
  M5.Display.fillScreen(kBg);

  for (Face* f : gFaces) loadFace(*f);

  gBand.setColorDepth(16);
  if (!gBand.createSprite(kContentW, kBandH)) Serial.println("display: band sprite alloc failed");
}

void displayProgress(const char* title, const char* detail, int percent) {
  auto& d = M5.Display;
  static int lastPercent = -2;
  if (!gProgressShown || gFullRedraw || percent < lastPercent) {
    d.fillScreen(kBg);
    gProgressShown = true;
    gFullRedraw = false;
    gDebugShown = true;  // the main screen repaints fully afterwards
    lastPercent = -2;
  }
  d.setTextDatum(textdatum_t::middle_center);
  d.setTextPadding(kContentW);
  d.setFont(&fonts::FreeSansBold12pt7b);
  d.setTextSize(1);
  d.setTextColor(kClockColor, kBg);
  d.drawString(title, kW / 2, kH / 2 - 36);
  d.setFont(&fonts::Font2);
  d.setTextColor(kDim, kBg);
  d.drawString(detail, kW / 2, kH / 2 + 34);
  d.setTextPadding(0);
  if (percent >= 0 && percent != lastPercent) {
    constexpr int kBarH = 8;
    int y = kH / 2 - kBarH / 2;
    d.fillRoundRect(kPadX, y, kContentW, kBarH, kBarH / 2, kDivider);
    int w = kContentW * std::min(percent, 100) / 100;
    if (w > 0) d.fillRoundRect(kPadX, y, std::max(w, kBarH), kBarH, kBarH / 2, kGreen);
  }
  lastPercent = percent;
}

void displayInvalidate() { gFullRedraw = true; }

void displaySplash(const SplashModel& m, const char* version) {
  if (!gBand.getBuffer()) return;
  bool full = !gSplashShown || gFullRedraw;
  if (full) {
    M5.Display.fillScreen(kBg);
    renderRegion(kSplashHeadY, kSplashHeadH, [&](LGFX_Sprite& s, int oy) {
      drawLogo(s, kContentW / 2, oy + 36);
      drawText(s, gTitleFace, "Nightscout Bedside", kContentW / 2, oy + 79, Align::Center, kClockColor);
      char line[40];
      snprintf(line, sizeof(line), "v%s  \xC2\xB7  M5Stack Basic", version);
      drawText(s, gSmallFace, line, kContentW / 2, oy + 104, Align::Center, kGrey);
    });
    M5.Display.drawFastHLine(kPadX, kSplashRuleY, kContentW, kDivider);
  }

  bool listChanged = full;
  for (int i = 0; i < 4; i++) listChanged |= !sameStep(m.steps[i], gSplashDrawn.steps[i]);
  for (const SplashStep& st : m.steps)  // animate only while something is waiting
    if (st.state == StepState::Wait && m.frame != gSplashDrawn.frame) listChanged = true;
  if (listChanged) {
    renderRegion(kSplashListY, kSplashListH, [&](LGFX_Sprite& s, int oy) {
      for (int i = 0; i < 4; i++) {
        const SplashStep& st = m.steps[i];
        int cy = oy + i * kSplashRowH + kSplashRowH / 2;
        drawStepIcon(s, st.state, kSplashIconX, cy, m.frame);
        drawText(s, gSmallFace, st.label, kSplashLabelX, cy, Align::Left,
                 st.state == StepState::Todo ? kGrey : kClockColor);
        uint32_t c = st.state == StepState::Ok ? kGreen : st.state == StepState::Fail ? kRed : kDim;
        drawText(s, gSmallFace, st.detail, kSplashDetailX, cy, Align::Right, c);
      }
    });
  }

  if (full || strcmp(m.footer, gSplashDrawn.footer) || m.footerAlert != gSplashDrawn.footerAlert) {
    renderRegion(kSplashFootY, kSplashFootH, [&](LGFX_Sprite& s, int oy) {
      drawText(s, gSmallFace, m.footer, kContentW / 2, oy + kSplashFootH / 2, Align::Center,
               m.footerAlert ? kRed : kDim);
    });
  }

  gSplashDrawn = m;
  gSplashShown = true;
  gFullRedraw = false;
  gDebugShown = true;  // the next page paints from scratch
  gProgressShown = false;
}

void displayUpdate(const ScreenModel& m) {
  if (!gBand.getBuffer()) return;
  bool full = gFullRedraw || gDebugShown;
  if (full) {
    M5.Display.fillScreen(kBg);
    M5.Display.drawFastHLine(kPadX, kDividerY, kContentW, kDivider);
  }
  if (full || strcmp(m.date, gShown.date) || strcmp(m.temp, gShown.temp)) drawTopLine(m);
  if (full || strcmp(m.time, gShown.time)) drawClock(m);
  if (full || stripChanged(m, gShown)) drawStrip(m);
  gShown = m;
  gFullRedraw = false;
  gDebugShown = false;
  gProgressShown = false;
}

void displayDebug(const char* const* lines, int count) {
  auto& d = M5.Display;
  count = std::min(count, kDebugMaxLines);
  bool full = !gDebugShown || gFullRedraw;
  if (full) {
    d.fillScreen(kBg);
    memset(gDebugLines, 0, sizeof(gDebugLines));
  }
  d.setFont(&fonts::Font2);
  d.setTextSize(1);
  d.setTextDatum(textdatum_t::top_left);
  d.setTextPadding(kW - 2 * 8);  // overwrite the previous text on the line
  for (int i = 0; i < count; i++) {
    if (!full && strcmp(lines[i], gDebugLines[i]) == 0) continue;
    strlcpy(gDebugLines[i], lines[i], sizeof(gDebugLines[i]));
    d.setTextColor(i == 0 ? kClockColor : kDim, kBg);
    d.drawString(lines[i], 8, 6 + i * 16);
  }
  d.setTextPadding(0);
  gDebugShown = true;
  gFullRedraw = false;
  gProgressShown = false;
}
